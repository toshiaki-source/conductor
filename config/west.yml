## config/west.yml
```yaml
manifest:
  remotes:
    - name: zmkfirmware
      url-base: https://github.com/zmkfirmware
    - name: pite1222
      url-base: https://github.com/pite1222
    - name: caksoylar  # <-- new entry
      url-base: https://github.com/caksoylar
    - name: cormoran
      url-base: https://github.com/cormoran
  projects:
    - name: zmk
      remote: cormoran
      revision: v0.3+custom-studio-protocol
      import:
        file: app/west.yml
    - name: zmk-pmw3610-driver
      remote: pite1222
      revision: main
    - name: zmk-rgbled-widget  # <-- new entry
      remote: caksoylar
      revision: main
    - name: zmk-module-runtime-input-processor
      remote: cormoran
      revision: main # or latest commit hash
      # Below setting required to use unofficial studio custom RPC feature
  self:
    path: config
```
